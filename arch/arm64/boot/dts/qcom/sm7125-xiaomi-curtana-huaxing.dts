// SPDX-License-Identifier: GPL-2.0
/*
 * Copyright (C) 2025 Vitalii Skorkin <nikroksm@mail.ru>
 */

/dts-v1/;

#include "sm7125-xiaomi-curtana.dtsi"

/ {
	compatible = "xiaomi,curtana-huaxing", "xiaomi,curtana", "qcom,sm7125";
	model = "Xiaomi Redmi Note 9S (Huaxing)";
};

&panel { compatible = "huaxing,ft8756"; };
&touchscreen {
	compatible = "focaltech,ft8756-spi";
	firmware-name = "focaltech_ts_fw_huaxing.bin";
};
