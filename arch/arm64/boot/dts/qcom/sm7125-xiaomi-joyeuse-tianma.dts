// SPDX-License-Identifier: GPL-2.0
/*
 * Copyright (c) 2021, The Linux Foundation. All rights reserved.
 * Copyright (C) 2025 Vitalii Skorkin <nikroksm@mail.ru>
 */

/dts-v1/;

#include "sm7125-xiaomi-joyeuse.dtsi"

/ {
	model = "Xiaomi Redmi Note 9 Pro (Global, Tianma)";
};

&panel { compatible = "tianma,nt36675"; };
&touchscreen {
	compatible = "novatek,nt36xxx-spi";
	firmware-name = "novatek_ts_tianma_fw.bin";
};